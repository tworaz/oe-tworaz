## meta-jlime/conf/distro/Jlime.conf
```bitbake
#-----------------------------------------------------------------------------
#@TYPE: Distribution
#@NAME: Jlime 2012-pre0
#@DESCRIPTION:
#@MAINTAINER:
#-----------------------------------------------------------------------------

#
# Header
#
DISTRO_NAME = "Jlime"
DISTRO_VERSION = "2012.0-pre2"
DISTRO_TYPE = "release"

# Generate locales on the buildsystem instead of on the target. Speeds up first boot, set to "1" to enable
ENABLE_BINARY_LOCALE_GENERATION ?= "1"

# We only want to build UTF8 locales
LOCALE_UTF8_ONLY = "1"

#
# Distribution features
#
DISTRO_FEATURES  = "alsa argp bluetooth ext2 irda largefile pam pcmcia usbhost wifi xattr x11"
DISTRO_FEATURES += "${DISTRO_FEATURES_LIBC}"

#
# Toolchain configuration
#
TCMODE = "default"
TCLIBC = "eglibc"
TCLIBCAPPEND = ""

GCCVERSION = "4.6%"
SDKGCCVERSION = "4.6%"
BINUVERSION = "2.22"
EGLIBCVERSION = "2.13"
UCLIBCVERSION = "0.9.33"

#
# Preferred instruction set for ARM
#
PREFERRED_ARM_INSTRUCTION_SET ?= "thumb"
ARM_INSTRUCTION_SET = "${PREFERRED_ARM_INSTRUCTION_SET}"

#
# Image naming scheme
#
IMAGE_NAME = "${IMAGE_BASENAME}-${DISTRO_VERSION}-${MACHINE}-${DATE}"
IMAGE_FSTYPES = "tar.gz tar.bz2"
SPLASH = "psplash"

#
# Ensure MACHINE_CLASS is in OVERRIDES
#
MACHINE_CLASS ?= ""
MACHINEOVERRIDES .= ":${MACHINE_CLASS}"
MACHINEOVERRIDES[vardepsexclude] = "MACHINE"
OVERRIDES[vardepsexclude] = "MACHINE"
OVERRIDES .= ":jlime"

#
# Naming schemes
#
USER_CLASSES ?= ""
PACKAGE_CLASSES ?= "package_ipk"
INHERIT_INSANE ?= "insane"
INHERIT_DISTRO ?= "debian devshell sstate license"
INHERIT += "${PACKAGE_CLASSES} ${USER_CLASSES} ${INHERIT_INSANE} ${INHERIT_DISTRO}"
SRC_DIST_LOCAL ?= "symlink"

#
# Preferred providers
#
PREFERRED_PROVIDER_virtual/update-alternatives = "opkg"
PREFERRED_PROVIDER_virtual/libgl = "mesa-xlib"
PREFERRED_PROVIDER_gconf = "gconf"
PREFERRED_PROVIDER_gconf-dbus = "gconf"
PREFERRED_PROVIDER_gconf-native = "gconf-native"
PREFERRED_PROVIDER_jpeg = "jpeg"
PREFERRED_PROVIDER_jpeg-native = "libjpeg-turbo-native"
PREFERRED_PROVIDER_mplayer = "mplayer2"

#
# Preferred versions
#
PREFERRED_VERSION_freerdp = "0.8.2"

#
# Runtime virtuals
#
VIRTUAL-RUNTIME_graphical_init_manager = "lxdm"
```

## meta-netbookpro/conf/machine/netbookpro.conf
```bitbake
#@TYPE: Machine
#@Name: Psion Teklogix NetBook Pro
#@DESCRIPTION: Machine configuration for Psion Teklogix NetBook Pro

TARGET_ARCH = "arm"

require conf/machine/include/tune-xscale.inc

# Kernel
PREFERRED_PROVIDER_virtual/kernel = "linux-netbookpro"
KERNEL_IMAGETYPE="Image"

# Features
PCMCIA_MANAGER = "pcmciautils"
MACHINE_FEATURES = "ext2 kernel26 touchscreen keyboard alsa pcmcia bluetooth irda usbhost screen wifi vfat"

# X11
PREFERRED_PROVIDER_virtual/xserver = "xserver-kdrive"
XSERVER = "xserver-kdrive-epson"

# Screen
MACHINE_GUI_CLASS = "bigscreen"
MACHINE_DISPLAY_WIDTH_PIXELS = "800"
MACHINE_DISPLAY_HEIGHT_PIXELS = "600"

# Console configuration
SERIAL_CONSOLE = "115200 ttyS0 vt100"
SYSVINIT_ENABLED_GETTYS = "1 2 3"
```
